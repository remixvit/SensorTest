.ifndef INCLUDED_CYFITTERGNU_INC
.set INCLUDED_CYFITTERGNU_INC, 1
.include "cydevicegnu_trm.inc"

/* ADC_cy_psoc4_sar */
.set ADC_cy_psoc4_sar__SAR_CTRL, CYREG_SAR_CTRL
.set ADC_cy_psoc4_sar__SAR_INTR, CYREG_SAR_INTR
.set ADC_cy_psoc4_sar__SAR_INTR_CAUSE, CYREG_SAR_INTR_CAUSE
.set ADC_cy_psoc4_sar__SAR_INTR_MASK, CYREG_SAR_INTR_MASK
.set ADC_cy_psoc4_sar__SAR_INTR_MASKED, CYREG_SAR_INTR_MASKED
.set ADC_cy_psoc4_sar__SAR_INTR_SET, CYREG_SAR_INTR_SET
.set ADC_cy_psoc4_sar__SAR_NUMBER, 0
.set ADC_cy_psoc4_sar__SAR_RANGE_COND, CYREG_SAR_RANGE_COND
.set ADC_cy_psoc4_sar__SAR_RANGE_INTR_MASK, CYREG_SAR_RANGE_INTR_MASK
.set ADC_cy_psoc4_sar__SAR_RANGE_INTR_MASKED, CYREG_SAR_RANGE_INTR_MASKED
.set ADC_cy_psoc4_sar__SAR_RANGE_INTR_SET, CYREG_SAR_RANGE_INTR_SET
.set ADC_cy_psoc4_sar__SAR_RANGE_THRES, CYREG_SAR_RANGE_THRES
.set ADC_cy_psoc4_sar__SAR_SAMPLE_CTRL, CYREG_SAR_SAMPLE_CTRL
.set ADC_cy_psoc4_sar__SAR_SAMPLE_TIME01, CYREG_SAR_SAMPLE_TIME01
.set ADC_cy_psoc4_sar__SAR_SAMPLE_TIME23, CYREG_SAR_SAMPLE_TIME23
.set ADC_cy_psoc4_sar__SAR_SATURATE_INTR_MASK, CYREG_SAR_SATURATE_INTR_MASK
.set ADC_cy_psoc4_sar__SAR_SATURATE_INTR_MASKED, CYREG_SAR_SATURATE_INTR_MASKED
.set ADC_cy_psoc4_sar__SAR_SATURATE_INTR_SET, CYREG_SAR_SATURATE_INTR_SET
.set ADC_cy_psoc4_sar__SAR_STATUS, CYREG_SAR_STATUS

/* ADC_intClock */
.set ADC_intClock__DIVIDER_MASK, 0x0000FFFF
.set ADC_intClock__ENABLE, CYREG_CLK_DIVIDER_C00
.set ADC_intClock__ENABLE_MASK, 0x80000000
.set ADC_intClock__MASK, 0x80000000
.set ADC_intClock__REGISTER, CYREG_CLK_DIVIDER_C00

/* ADC_IRQ */
.set ADC_IRQ__INTC_CLR_EN_REG, CYREG_CM0_ICER
.set ADC_IRQ__INTC_CLR_PD_REG, CYREG_CM0_ICPR
.set ADC_IRQ__INTC_MASK, 0x4000
.set ADC_IRQ__INTC_NUMBER, 14
.set ADC_IRQ__INTC_PRIOR_MASK, 0xC00000
.set ADC_IRQ__INTC_PRIOR_NUM, 3
.set ADC_IRQ__INTC_PRIOR_REG, CYREG_CM0_IPR3
.set ADC_IRQ__INTC_SET_EN_REG, CYREG_CM0_ISER
.set ADC_IRQ__INTC_SET_PD_REG, CYREG_CM0_ISPR

/* I2C_SCB */
.set I2C_SCB__BIST_CONTROL, CYREG_SCB1_BIST_CONTROL
.set I2C_SCB__BIST_DATA, CYREG_SCB1_BIST_DATA
.set I2C_SCB__CTRL, CYREG_SCB1_CTRL
.set I2C_SCB__EZ_DATA00, CYREG_SCB1_EZ_DATA00
.set I2C_SCB__EZ_DATA01, CYREG_SCB1_EZ_DATA01
.set I2C_SCB__EZ_DATA02, CYREG_SCB1_EZ_DATA02
.set I2C_SCB__EZ_DATA03, CYREG_SCB1_EZ_DATA03
.set I2C_SCB__EZ_DATA04, CYREG_SCB1_EZ_DATA04
.set I2C_SCB__EZ_DATA05, CYREG_SCB1_EZ_DATA05
.set I2C_SCB__EZ_DATA06, CYREG_SCB1_EZ_DATA06
.set I2C_SCB__EZ_DATA07, CYREG_SCB1_EZ_DATA07
.set I2C_SCB__EZ_DATA08, CYREG_SCB1_EZ_DATA08
.set I2C_SCB__EZ_DATA09, CYREG_SCB1_EZ_DATA09
.set I2C_SCB__EZ_DATA10, CYREG_SCB1_EZ_DATA10
.set I2C_SCB__EZ_DATA11, CYREG_SCB1_EZ_DATA11
.set I2C_SCB__EZ_DATA12, CYREG_SCB1_EZ_DATA12
.set I2C_SCB__EZ_DATA13, CYREG_SCB1_EZ_DATA13
.set I2C_SCB__EZ_DATA14, CYREG_SCB1_EZ_DATA14
.set I2C_SCB__EZ_DATA15, CYREG_SCB1_EZ_DATA15
.set I2C_SCB__EZ_DATA16, CYREG_SCB1_EZ_DATA16
.set I2C_SCB__EZ_DATA17, CYREG_SCB1_EZ_DATA17
.set I2C_SCB__EZ_DATA18, CYREG_SCB1_EZ_DATA18
.set I2C_SCB__EZ_DATA19, CYREG_SCB1_EZ_DATA19
.set I2C_SCB__EZ_DATA20, CYREG_SCB1_EZ_DATA20
.set I2C_SCB__EZ_DATA21, CYREG_SCB1_EZ_DATA21
.set I2C_SCB__EZ_DATA22, CYREG_SCB1_EZ_DATA22
.set I2C_SCB__EZ_DATA23, CYREG_SCB1_EZ_DATA23
.set I2C_SCB__EZ_DATA24, CYREG_SCB1_EZ_DATA24
.set I2C_SCB__EZ_DATA25, CYREG_SCB1_EZ_DATA25
.set I2C_SCB__EZ_DATA26, CYREG_SCB1_EZ_DATA26
.set I2C_SCB__EZ_DATA27, CYREG_SCB1_EZ_DATA27
.set I2C_SCB__EZ_DATA28, CYREG_SCB1_EZ_DATA28
.set I2C_SCB__EZ_DATA29, CYREG_SCB1_EZ_DATA29
.set I2C_SCB__EZ_DATA30, CYREG_SCB1_EZ_DATA30
.set I2C_SCB__EZ_DATA31, CYREG_SCB1_EZ_DATA31
.set I2C_SCB__I2C_CFG, CYREG_SCB1_I2C_CFG
.set I2C_SCB__I2C_CTRL, CYREG_SCB1_I2C_CTRL
.set I2C_SCB__I2C_M_CMD, CYREG_SCB1_I2C_M_CMD
.set I2C_SCB__I2C_S_CMD, CYREG_SCB1_I2C_S_CMD
.set I2C_SCB__I2C_STATUS, CYREG_SCB1_I2C_STATUS
.set I2C_SCB__INTR_CAUSE, CYREG_SCB1_INTR_CAUSE
.set I2C_SCB__INTR_I2C_EC, CYREG_SCB1_INTR_I2C_EC
.set I2C_SCB__INTR_I2C_EC_MASK, CYREG_SCB1_INTR_I2C_EC_MASK
.set I2C_SCB__INTR_I2C_EC_MASKED, CYREG_SCB1_INTR_I2C_EC_MASKED
.set I2C_SCB__INTR_M, CYREG_SCB1_INTR_M
.set I2C_SCB__INTR_M_MASK, CYREG_SCB1_INTR_M_MASK
.set I2C_SCB__INTR_M_MASKED, CYREG_SCB1_INTR_M_MASKED
.set I2C_SCB__INTR_M_SET, CYREG_SCB1_INTR_M_SET
.set I2C_SCB__INTR_RX, CYREG_SCB1_INTR_RX
.set I2C_SCB__INTR_RX_MASK, CYREG_SCB1_INTR_RX_MASK
.set I2C_SCB__INTR_RX_MASKED, CYREG_SCB1_INTR_RX_MASKED
.set I2C_SCB__INTR_RX_SET, CYREG_SCB1_INTR_RX_SET
.set I2C_SCB__INTR_S, CYREG_SCB1_INTR_S
.set I2C_SCB__INTR_S_MASK, CYREG_SCB1_INTR_S_MASK
.set I2C_SCB__INTR_S_MASKED, CYREG_SCB1_INTR_S_MASKED
.set I2C_SCB__INTR_S_SET, CYREG_SCB1_INTR_S_SET
.set I2C_SCB__INTR_SPI_EC, CYREG_SCB1_INTR_SPI_EC
.set I2C_SCB__INTR_SPI_EC_MASK, CYREG_SCB1_INTR_SPI_EC_MASK
.set I2C_SCB__INTR_SPI_EC_MASKED, CYREG_SCB1_INTR_SPI_EC_MASKED
.set I2C_SCB__INTR_TX, CYREG_SCB1_INTR_TX
.set I2C_SCB__INTR_TX_MASK, CYREG_SCB1_INTR_TX_MASK
.set I2C_SCB__INTR_TX_MASKED, CYREG_SCB1_INTR_TX_MASKED
.set I2C_SCB__INTR_TX_SET, CYREG_SCB1_INTR_TX_SET
.set I2C_SCB__RX_CTRL, CYREG_SCB1_RX_CTRL
.set I2C_SCB__RX_FIFO_CTRL, CYREG_SCB1_RX_FIFO_CTRL
.set I2C_SCB__RX_FIFO_RD, CYREG_SCB1_RX_FIFO_RD
.set I2C_SCB__RX_FIFO_RD_SILENT, CYREG_SCB1_RX_FIFO_RD_SILENT
.set I2C_SCB__RX_FIFO_STATUS, CYREG_SCB1_RX_FIFO_STATUS
.set I2C_SCB__RX_MATCH, CYREG_SCB1_RX_MATCH
.set I2C_SCB__SPI_CTRL, CYREG_SCB1_SPI_CTRL
.set I2C_SCB__SPI_STATUS, CYREG_SCB1_SPI_STATUS
.set I2C_SCB__SS0_POSISTION, 0
.set I2C_SCB__SS1_POSISTION, 1
.set I2C_SCB__SS2_POSISTION, 2
.set I2C_SCB__SS3_POSISTION, 3
.set I2C_SCB__STATUS, CYREG_SCB1_STATUS
.set I2C_SCB__TX_CTRL, CYREG_SCB1_TX_CTRL
.set I2C_SCB__TX_FIFO_CTRL, CYREG_SCB1_TX_FIFO_CTRL
.set I2C_SCB__TX_FIFO_STATUS, CYREG_SCB1_TX_FIFO_STATUS
.set I2C_SCB__TX_FIFO_WR, CYREG_SCB1_TX_FIFO_WR
.set I2C_SCB__UART_CTRL, CYREG_SCB1_UART_CTRL
.set I2C_SCB__UART_RX_CTRL, CYREG_SCB1_UART_RX_CTRL
.set I2C_SCB__UART_RX_STATUS, CYREG_SCB1_UART_RX_STATUS
.set I2C_SCB__UART_TX_CTRL, CYREG_SCB1_UART_TX_CTRL

/* I2C_SCB_IRQ */
.set I2C_SCB_IRQ__INTC_CLR_EN_REG, CYREG_CM0_ICER
.set I2C_SCB_IRQ__INTC_CLR_PD_REG, CYREG_CM0_ICPR
.set I2C_SCB_IRQ__INTC_MASK, 0x800
.set I2C_SCB_IRQ__INTC_NUMBER, 11
.set I2C_SCB_IRQ__INTC_PRIOR_MASK, 0xC0000000
.set I2C_SCB_IRQ__INTC_PRIOR_NUM, 3
.set I2C_SCB_IRQ__INTC_PRIOR_REG, CYREG_CM0_IPR2
.set I2C_SCB_IRQ__INTC_SET_EN_REG, CYREG_CM0_ISER
.set I2C_SCB_IRQ__INTC_SET_PD_REG, CYREG_CM0_ISPR

/* I2C_SCBCLK */
.set I2C_SCBCLK__DIVIDER_MASK, 0x0000FFFF
.set I2C_SCBCLK__ENABLE, CYREG_CLK_DIVIDER_B00
.set I2C_SCBCLK__ENABLE_MASK, 0x80000000
.set I2C_SCBCLK__MASK, 0x80000000
.set I2C_SCBCLK__REGISTER, CYREG_CLK_DIVIDER_B00

/* I2C_scl */
.set I2C_scl__0__DM__MASK, 0x7000
.set I2C_scl__0__DM__SHIFT, 12
.set I2C_scl__0__DR, CYREG_PRT0_DR
.set I2C_scl__0__HSIOM, CYREG_HSIOM_PORT_SEL0
.set I2C_scl__0__HSIOM_MASK, 0x000F0000
.set I2C_scl__0__HSIOM_SHIFT, 16
.set I2C_scl__0__INTCFG, CYREG_PRT0_INTCFG
.set I2C_scl__0__INTSTAT, CYREG_PRT0_INTSTAT
.set I2C_scl__0__MASK, 0x10
.set I2C_scl__0__PA__CFG0, CYREG_UDB_PA0_CFG0
.set I2C_scl__0__PA__CFG1, CYREG_UDB_PA0_CFG1
.set I2C_scl__0__PA__CFG10, CYREG_UDB_PA0_CFG10
.set I2C_scl__0__PA__CFG11, CYREG_UDB_PA0_CFG11
.set I2C_scl__0__PA__CFG12, CYREG_UDB_PA0_CFG12
.set I2C_scl__0__PA__CFG13, CYREG_UDB_PA0_CFG13
.set I2C_scl__0__PA__CFG14, CYREG_UDB_PA0_CFG14
.set I2C_scl__0__PA__CFG2, CYREG_UDB_PA0_CFG2
.set I2C_scl__0__PA__CFG3, CYREG_UDB_PA0_CFG3
.set I2C_scl__0__PA__CFG4, CYREG_UDB_PA0_CFG4
.set I2C_scl__0__PA__CFG5, CYREG_UDB_PA0_CFG5
.set I2C_scl__0__PA__CFG6, CYREG_UDB_PA0_CFG6
.set I2C_scl__0__PA__CFG7, CYREG_UDB_PA0_CFG7
.set I2C_scl__0__PA__CFG8, CYREG_UDB_PA0_CFG8
.set I2C_scl__0__PA__CFG9, CYREG_UDB_PA0_CFG9
.set I2C_scl__0__PC, CYREG_PRT0_PC
.set I2C_scl__0__PC2, CYREG_PRT0_PC2
.set I2C_scl__0__PORT, 0
.set I2C_scl__0__PS, CYREG_PRT0_PS
.set I2C_scl__0__SHIFT, 4
.set I2C_scl__DR, CYREG_PRT0_DR
.set I2C_scl__INTCFG, CYREG_PRT0_INTCFG
.set I2C_scl__INTSTAT, CYREG_PRT0_INTSTAT
.set I2C_scl__MASK, 0x10
.set I2C_scl__PA__CFG0, CYREG_UDB_PA0_CFG0
.set I2C_scl__PA__CFG1, CYREG_UDB_PA0_CFG1
.set I2C_scl__PA__CFG10, CYREG_UDB_PA0_CFG10
.set I2C_scl__PA__CFG11, CYREG_UDB_PA0_CFG11
.set I2C_scl__PA__CFG12, CYREG_UDB_PA0_CFG12
.set I2C_scl__PA__CFG13, CYREG_UDB_PA0_CFG13
.set I2C_scl__PA__CFG14, CYREG_UDB_PA0_CFG14
.set I2C_scl__PA__CFG2, CYREG_UDB_PA0_CFG2
.set I2C_scl__PA__CFG3, CYREG_UDB_PA0_CFG3
.set I2C_scl__PA__CFG4, CYREG_UDB_PA0_CFG4
.set I2C_scl__PA__CFG5, CYREG_UDB_PA0_CFG5
.set I2C_scl__PA__CFG6, CYREG_UDB_PA0_CFG6
.set I2C_scl__PA__CFG7, CYREG_UDB_PA0_CFG7
.set I2C_scl__PA__CFG8, CYREG_UDB_PA0_CFG8
.set I2C_scl__PA__CFG9, CYREG_UDB_PA0_CFG9
.set I2C_scl__PC, CYREG_PRT0_PC
.set I2C_scl__PC2, CYREG_PRT0_PC2
.set I2C_scl__PORT, 0
.set I2C_scl__PS, CYREG_PRT0_PS
.set I2C_scl__SHIFT, 4

/* I2C_sda */
.set I2C_sda__0__DM__MASK, 0x38000
.set I2C_sda__0__DM__SHIFT, 15
.set I2C_sda__0__DR, CYREG_PRT0_DR
.set I2C_sda__0__HSIOM, CYREG_HSIOM_PORT_SEL0
.set I2C_sda__0__HSIOM_MASK, 0x00F00000
.set I2C_sda__0__HSIOM_SHIFT, 20
.set I2C_sda__0__INTCFG, CYREG_PRT0_INTCFG
.set I2C_sda__0__INTSTAT, CYREG_PRT0_INTSTAT
.set I2C_sda__0__MASK, 0x20
.set I2C_sda__0__PA__CFG0, CYREG_UDB_PA0_CFG0
.set I2C_sda__0__PA__CFG1, CYREG_UDB_PA0_CFG1
.set I2C_sda__0__PA__CFG10, CYREG_UDB_PA0_CFG10
.set I2C_sda__0__PA__CFG11, CYREG_UDB_PA0_CFG11
.set I2C_sda__0__PA__CFG12, CYREG_UDB_PA0_CFG12
.set I2C_sda__0__PA__CFG13, CYREG_UDB_PA0_CFG13
.set I2C_sda__0__PA__CFG14, CYREG_UDB_PA0_CFG14
.set I2C_sda__0__PA__CFG2, CYREG_UDB_PA0_CFG2
.set I2C_sda__0__PA__CFG3, CYREG_UDB_PA0_CFG3
.set I2C_sda__0__PA__CFG4, CYREG_UDB_PA0_CFG4
.set I2C_sda__0__PA__CFG5, CYREG_UDB_PA0_CFG5
.set I2C_sda__0__PA__CFG6, CYREG_UDB_PA0_CFG6
.set I2C_sda__0__PA__CFG7, CYREG_UDB_PA0_CFG7
.set I2C_sda__0__PA__CFG8, CYREG_UDB_PA0_CFG8
.set I2C_sda__0__PA__CFG9, CYREG_UDB_PA0_CFG9
.set I2C_sda__0__PC, CYREG_PRT0_PC
.set I2C_sda__0__PC2, CYREG_PRT0_PC2
.set I2C_sda__0__PORT, 0
.set I2C_sda__0__PS, CYREG_PRT0_PS
.set I2C_sda__0__SHIFT, 5
.set I2C_sda__DR, CYREG_PRT0_DR
.set I2C_sda__INTCFG, CYREG_PRT0_INTCFG
.set I2C_sda__INTSTAT, CYREG_PRT0_INTSTAT
.set I2C_sda__MASK, 0x20
.set I2C_sda__PA__CFG0, CYREG_UDB_PA0_CFG0
.set I2C_sda__PA__CFG1, CYREG_UDB_PA0_CFG1
.set I2C_sda__PA__CFG10, CYREG_UDB_PA0_CFG10
.set I2C_sda__PA__CFG11, CYREG_UDB_PA0_CFG11
.set I2C_sda__PA__CFG12, CYREG_UDB_PA0_CFG12
.set I2C_sda__PA__CFG13, CYREG_UDB_PA0_CFG13
.set I2C_sda__PA__CFG14, CYREG_UDB_PA0_CFG14
.set I2C_sda__PA__CFG2, CYREG_UDB_PA0_CFG2
.set I2C_sda__PA__CFG3, CYREG_UDB_PA0_CFG3
.set I2C_sda__PA__CFG4, CYREG_UDB_PA0_CFG4
.set I2C_sda__PA__CFG5, CYREG_UDB_PA0_CFG5
.set I2C_sda__PA__CFG6, CYREG_UDB_PA0_CFG6
.set I2C_sda__PA__CFG7, CYREG_UDB_PA0_CFG7
.set I2C_sda__PA__CFG8, CYREG_UDB_PA0_CFG8
.set I2C_sda__PA__CFG9, CYREG_UDB_PA0_CFG9
.set I2C_sda__PC, CYREG_PRT0_PC
.set I2C_sda__PC2, CYREG_PRT0_PC2
.set I2C_sda__PORT, 0
.set I2C_sda__PS, CYREG_PRT0_PS
.set I2C_sda__SHIFT, 5

/* Clk_1 */
.set Clk_1__0__DM__MASK, 0x7000
.set Clk_1__0__DM__SHIFT, 12
.set Clk_1__0__DR, CYREG_PRT3_DR
.set Clk_1__0__HSIOM, CYREG_HSIOM_PORT_SEL3
.set Clk_1__0__HSIOM_MASK, 0x000F0000
.set Clk_1__0__HSIOM_SHIFT, 16
.set Clk_1__0__INTCFG, CYREG_PRT3_INTCFG
.set Clk_1__0__INTSTAT, CYREG_PRT3_INTSTAT
.set Clk_1__0__MASK, 0x10
.set Clk_1__0__OUT_SEL, CYREG_UDB_PA3_CFG10
.set Clk_1__0__OUT_SEL_SHIFT, 8
.set Clk_1__0__OUT_SEL_VAL, 3
.set Clk_1__0__PA__CFG0, CYREG_UDB_PA3_CFG0
.set Clk_1__0__PA__CFG1, CYREG_UDB_PA3_CFG1
.set Clk_1__0__PA__CFG10, CYREG_UDB_PA3_CFG10
.set Clk_1__0__PA__CFG11, CYREG_UDB_PA3_CFG11
.set Clk_1__0__PA__CFG12, CYREG_UDB_PA3_CFG12
.set Clk_1__0__PA__CFG13, CYREG_UDB_PA3_CFG13
.set Clk_1__0__PA__CFG14, CYREG_UDB_PA3_CFG14
.set Clk_1__0__PA__CFG2, CYREG_UDB_PA3_CFG2
.set Clk_1__0__PA__CFG3, CYREG_UDB_PA3_CFG3
.set Clk_1__0__PA__CFG4, CYREG_UDB_PA3_CFG4
.set Clk_1__0__PA__CFG5, CYREG_UDB_PA3_CFG5
.set Clk_1__0__PA__CFG6, CYREG_UDB_PA3_CFG6
.set Clk_1__0__PA__CFG7, CYREG_UDB_PA3_CFG7
.set Clk_1__0__PA__CFG8, CYREG_UDB_PA3_CFG8
.set Clk_1__0__PA__CFG9, CYREG_UDB_PA3_CFG9
.set Clk_1__0__PC, CYREG_PRT3_PC
.set Clk_1__0__PC2, CYREG_PRT3_PC2
.set Clk_1__0__PORT, 3
.set Clk_1__0__PS, CYREG_PRT3_PS
.set Clk_1__0__SHIFT, 4
.set Clk_1__DR, CYREG_PRT3_DR
.set Clk_1__INTCFG, CYREG_PRT3_INTCFG
.set Clk_1__INTSTAT, CYREG_PRT3_INTSTAT
.set Clk_1__MASK, 0x10
.set Clk_1__PA__CFG0, CYREG_UDB_PA3_CFG0
.set Clk_1__PA__CFG1, CYREG_UDB_PA3_CFG1
.set Clk_1__PA__CFG10, CYREG_UDB_PA3_CFG10
.set Clk_1__PA__CFG11, CYREG_UDB_PA3_CFG11
.set Clk_1__PA__CFG12, CYREG_UDB_PA3_CFG12
.set Clk_1__PA__CFG13, CYREG_UDB_PA3_CFG13
.set Clk_1__PA__CFG14, CYREG_UDB_PA3_CFG14
.set Clk_1__PA__CFG2, CYREG_UDB_PA3_CFG2
.set Clk_1__PA__CFG3, CYREG_UDB_PA3_CFG3
.set Clk_1__PA__CFG4, CYREG_UDB_PA3_CFG4
.set Clk_1__PA__CFG5, CYREG_UDB_PA3_CFG5
.set Clk_1__PA__CFG6, CYREG_UDB_PA3_CFG6
.set Clk_1__PA__CFG7, CYREG_UDB_PA3_CFG7
.set Clk_1__PA__CFG8, CYREG_UDB_PA3_CFG8
.set Clk_1__PA__CFG9, CYREG_UDB_PA3_CFG9
.set Clk_1__PC, CYREG_PRT3_PC
.set Clk_1__PC2, CYREG_PRT3_PC2
.set Clk_1__PORT, 3
.set Clk_1__PS, CYREG_PRT3_PS
.set Clk_1__SHIFT, 4

/* Clk_2 */
.set Clk_2__0__DM__MASK, 0x38000
.set Clk_2__0__DM__SHIFT, 15
.set Clk_2__0__DR, CYREG_PRT3_DR
.set Clk_2__0__HSIOM, CYREG_HSIOM_PORT_SEL3
.set Clk_2__0__HSIOM_MASK, 0x00F00000
.set Clk_2__0__HSIOM_SHIFT, 20
.set Clk_2__0__INTCFG, CYREG_PRT3_INTCFG
.set Clk_2__0__INTSTAT, CYREG_PRT3_INTSTAT
.set Clk_2__0__MASK, 0x20
.set Clk_2__0__OUT_SEL, CYREG_UDB_PA3_CFG10
.set Clk_2__0__OUT_SEL_SHIFT, 10
.set Clk_2__0__OUT_SEL_VAL, 0
.set Clk_2__0__PA__CFG0, CYREG_UDB_PA3_CFG0
.set Clk_2__0__PA__CFG1, CYREG_UDB_PA3_CFG1
.set Clk_2__0__PA__CFG10, CYREG_UDB_PA3_CFG10
.set Clk_2__0__PA__CFG11, CYREG_UDB_PA3_CFG11
.set Clk_2__0__PA__CFG12, CYREG_UDB_PA3_CFG12
.set Clk_2__0__PA__CFG13, CYREG_UDB_PA3_CFG13
.set Clk_2__0__PA__CFG14, CYREG_UDB_PA3_CFG14
.set Clk_2__0__PA__CFG2, CYREG_UDB_PA3_CFG2
.set Clk_2__0__PA__CFG3, CYREG_UDB_PA3_CFG3
.set Clk_2__0__PA__CFG4, CYREG_UDB_PA3_CFG4
.set Clk_2__0__PA__CFG5, CYREG_UDB_PA3_CFG5
.set Clk_2__0__PA__CFG6, CYREG_UDB_PA3_CFG6
.set Clk_2__0__PA__CFG7, CYREG_UDB_PA3_CFG7
.set Clk_2__0__PA__CFG8, CYREG_UDB_PA3_CFG8
.set Clk_2__0__PA__CFG9, CYREG_UDB_PA3_CFG9
.set Clk_2__0__PC, CYREG_PRT3_PC
.set Clk_2__0__PC2, CYREG_PRT3_PC2
.set Clk_2__0__PORT, 3
.set Clk_2__0__PS, CYREG_PRT3_PS
.set Clk_2__0__SHIFT, 5
.set Clk_2__DR, CYREG_PRT3_DR
.set Clk_2__INTCFG, CYREG_PRT3_INTCFG
.set Clk_2__INTSTAT, CYREG_PRT3_INTSTAT
.set Clk_2__MASK, 0x20
.set Clk_2__PA__CFG0, CYREG_UDB_PA3_CFG0
.set Clk_2__PA__CFG1, CYREG_UDB_PA3_CFG1
.set Clk_2__PA__CFG10, CYREG_UDB_PA3_CFG10
.set Clk_2__PA__CFG11, CYREG_UDB_PA3_CFG11
.set Clk_2__PA__CFG12, CYREG_UDB_PA3_CFG12
.set Clk_2__PA__CFG13, CYREG_UDB_PA3_CFG13
.set Clk_2__PA__CFG14, CYREG_UDB_PA3_CFG14
.set Clk_2__PA__CFG2, CYREG_UDB_PA3_CFG2
.set Clk_2__PA__CFG3, CYREG_UDB_PA3_CFG3
.set Clk_2__PA__CFG4, CYREG_UDB_PA3_CFG4
.set Clk_2__PA__CFG5, CYREG_UDB_PA3_CFG5
.set Clk_2__PA__CFG6, CYREG_UDB_PA3_CFG6
.set Clk_2__PA__CFG7, CYREG_UDB_PA3_CFG7
.set Clk_2__PA__CFG8, CYREG_UDB_PA3_CFG8
.set Clk_2__PA__CFG9, CYREG_UDB_PA3_CFG9
.set Clk_2__PC, CYREG_PRT3_PC
.set Clk_2__PC2, CYREG_PRT3_PC2
.set Clk_2__PORT, 3
.set Clk_2__PS, CYREG_PRT3_PS
.set Clk_2__SHIFT, 5

/* Timer_cy_m0s8_tcpwm_1 */
.set Timer_cy_m0s8_tcpwm_1__CC, CYREG_TCPWM_CNT0_CC
.set Timer_cy_m0s8_tcpwm_1__CC_BUFF, CYREG_TCPWM_CNT0_CC_BUFF
.set Timer_cy_m0s8_tcpwm_1__COUNTER, CYREG_TCPWM_CNT0_COUNTER
.set Timer_cy_m0s8_tcpwm_1__CTRL, CYREG_TCPWM_CNT0_CTRL
.set Timer_cy_m0s8_tcpwm_1__INTR, CYREG_TCPWM_CNT0_INTR
.set Timer_cy_m0s8_tcpwm_1__INTR_MASK, CYREG_TCPWM_CNT0_INTR_MASK
.set Timer_cy_m0s8_tcpwm_1__INTR_MASKED, CYREG_TCPWM_CNT0_INTR_MASKED
.set Timer_cy_m0s8_tcpwm_1__INTR_SET, CYREG_TCPWM_CNT0_INTR_SET
.set Timer_cy_m0s8_tcpwm_1__PERIOD, CYREG_TCPWM_CNT0_PERIOD
.set Timer_cy_m0s8_tcpwm_1__PERIOD_BUFF, CYREG_TCPWM_CNT0_PERIOD_BUFF
.set Timer_cy_m0s8_tcpwm_1__STATUS, CYREG_TCPWM_CNT0_STATUS
.set Timer_cy_m0s8_tcpwm_1__TCPWM_CMD, CYREG_TCPWM_CMD
.set Timer_cy_m0s8_tcpwm_1__TCPWM_CMDCAPTURE_MASK, 0x01
.set Timer_cy_m0s8_tcpwm_1__TCPWM_CMDCAPTURE_SHIFT, 0
.set Timer_cy_m0s8_tcpwm_1__TCPWM_CMDRELOAD_MASK, 0x100
.set Timer_cy_m0s8_tcpwm_1__TCPWM_CMDRELOAD_SHIFT, 8
.set Timer_cy_m0s8_tcpwm_1__TCPWM_CMDSTART_MASK, 0x1000000
.set Timer_cy_m0s8_tcpwm_1__TCPWM_CMDSTART_SHIFT, 24
.set Timer_cy_m0s8_tcpwm_1__TCPWM_CMDSTOP_MASK, 0x10000
.set Timer_cy_m0s8_tcpwm_1__TCPWM_CMDSTOP_SHIFT, 16
.set Timer_cy_m0s8_tcpwm_1__TCPWM_CTRL, CYREG_TCPWM_CTRL
.set Timer_cy_m0s8_tcpwm_1__TCPWM_CTRL_MASK, 0x01
.set Timer_cy_m0s8_tcpwm_1__TCPWM_CTRL_SHIFT, 0
.set Timer_cy_m0s8_tcpwm_1__TCPWM_INTR_CAUSE, CYREG_TCPWM_INTR_CAUSE
.set Timer_cy_m0s8_tcpwm_1__TCPWM_INTR_CAUSE_MASK, 0x01
.set Timer_cy_m0s8_tcpwm_1__TCPWM_INTR_CAUSE_SHIFT, 0
.set Timer_cy_m0s8_tcpwm_1__TCPWM_NUMBER, 0
.set Timer_cy_m0s8_tcpwm_1__TR_CTRL0, CYREG_TCPWM_CNT0_TR_CTRL0
.set Timer_cy_m0s8_tcpwm_1__TR_CTRL1, CYREG_TCPWM_CNT0_TR_CTRL1
.set Timer_cy_m0s8_tcpwm_1__TR_CTRL2, CYREG_TCPWM_CNT0_TR_CTRL2

/* Timer_RTOS_ISR */
.set Timer_RTOS_ISR__INTC_CLR_EN_REG, CYREG_CM0_ICER
.set Timer_RTOS_ISR__INTC_CLR_PD_REG, CYREG_CM0_ICPR
.set Timer_RTOS_ISR__INTC_MASK, 0x01
.set Timer_RTOS_ISR__INTC_NUMBER, 0
.set Timer_RTOS_ISR__INTC_PRIOR_MASK, 0xC0
.set Timer_RTOS_ISR__INTC_PRIOR_NUM, 3
.set Timer_RTOS_ISR__INTC_PRIOR_REG, CYREG_CM0_IPR0
.set Timer_RTOS_ISR__INTC_SET_EN_REG, CYREG_CM0_ISER
.set Timer_RTOS_ISR__INTC_SET_PD_REG, CYREG_CM0_ISPR

/* Button */
.set Button__0__DM__MASK, 0xE00000
.set Button__0__DM__SHIFT, 21
.set Button__0__DR, CYREG_PRT0_DR
.set Button__0__HSIOM, CYREG_HSIOM_PORT_SEL0
.set Button__0__HSIOM_MASK, 0xF0000000
.set Button__0__HSIOM_SHIFT, 28
.set Button__0__INTCFG, CYREG_PRT0_INTCFG
.set Button__0__INTSTAT, CYREG_PRT0_INTSTAT
.set Button__0__MASK, 0x80
.set Button__0__PA__CFG0, CYREG_UDB_PA0_CFG0
.set Button__0__PA__CFG1, CYREG_UDB_PA0_CFG1
.set Button__0__PA__CFG10, CYREG_UDB_PA0_CFG10
.set Button__0__PA__CFG11, CYREG_UDB_PA0_CFG11
.set Button__0__PA__CFG12, CYREG_UDB_PA0_CFG12
.set Button__0__PA__CFG13, CYREG_UDB_PA0_CFG13
.set Button__0__PA__CFG14, CYREG_UDB_PA0_CFG14
.set Button__0__PA__CFG2, CYREG_UDB_PA0_CFG2
.set Button__0__PA__CFG3, CYREG_UDB_PA0_CFG3
.set Button__0__PA__CFG4, CYREG_UDB_PA0_CFG4
.set Button__0__PA__CFG5, CYREG_UDB_PA0_CFG5
.set Button__0__PA__CFG6, CYREG_UDB_PA0_CFG6
.set Button__0__PA__CFG7, CYREG_UDB_PA0_CFG7
.set Button__0__PA__CFG8, CYREG_UDB_PA0_CFG8
.set Button__0__PA__CFG9, CYREG_UDB_PA0_CFG9
.set Button__0__PC, CYREG_PRT0_PC
.set Button__0__PC2, CYREG_PRT0_PC2
.set Button__0__PORT, 0
.set Button__0__PS, CYREG_PRT0_PS
.set Button__0__SHIFT, 7
.set Button__DR, CYREG_PRT0_DR
.set Button__INTCFG, CYREG_PRT0_INTCFG
.set Button__INTSTAT, CYREG_PRT0_INTSTAT
.set Button__MASK, 0x80
.set Button__PA__CFG0, CYREG_UDB_PA0_CFG0
.set Button__PA__CFG1, CYREG_UDB_PA0_CFG1
.set Button__PA__CFG10, CYREG_UDB_PA0_CFG10
.set Button__PA__CFG11, CYREG_UDB_PA0_CFG11
.set Button__PA__CFG12, CYREG_UDB_PA0_CFG12
.set Button__PA__CFG13, CYREG_UDB_PA0_CFG13
.set Button__PA__CFG14, CYREG_UDB_PA0_CFG14
.set Button__PA__CFG2, CYREG_UDB_PA0_CFG2
.set Button__PA__CFG3, CYREG_UDB_PA0_CFG3
.set Button__PA__CFG4, CYREG_UDB_PA0_CFG4
.set Button__PA__CFG5, CYREG_UDB_PA0_CFG5
.set Button__PA__CFG6, CYREG_UDB_PA0_CFG6
.set Button__PA__CFG7, CYREG_UDB_PA0_CFG7
.set Button__PA__CFG8, CYREG_UDB_PA0_CFG8
.set Button__PA__CFG9, CYREG_UDB_PA0_CFG9
.set Button__PC, CYREG_PRT0_PC
.set Button__PC2, CYREG_PRT0_PC2
.set Button__PORT, 0
.set Button__PS, CYREG_PRT0_PS
.set Button__SHIFT, 7

/* Bat_ADC */
.set Bat_ADC__0__DM__MASK, 0x38
.set Bat_ADC__0__DM__SHIFT, 3
.set Bat_ADC__0__DR, CYREG_PRT2_DR
.set Bat_ADC__0__HSIOM, CYREG_HSIOM_PORT_SEL2
.set Bat_ADC__0__HSIOM_MASK, 0x000000F0
.set Bat_ADC__0__HSIOM_SHIFT, 4
.set Bat_ADC__0__INTCFG, CYREG_PRT2_INTCFG
.set Bat_ADC__0__INTSTAT, CYREG_PRT2_INTSTAT
.set Bat_ADC__0__MASK, 0x02
.set Bat_ADC__0__PA__CFG0, CYREG_UDB_PA2_CFG0
.set Bat_ADC__0__PA__CFG1, CYREG_UDB_PA2_CFG1
.set Bat_ADC__0__PA__CFG10, CYREG_UDB_PA2_CFG10
.set Bat_ADC__0__PA__CFG11, CYREG_UDB_PA2_CFG11
.set Bat_ADC__0__PA__CFG12, CYREG_UDB_PA2_CFG12
.set Bat_ADC__0__PA__CFG13, CYREG_UDB_PA2_CFG13
.set Bat_ADC__0__PA__CFG14, CYREG_UDB_PA2_CFG14
.set Bat_ADC__0__PA__CFG2, CYREG_UDB_PA2_CFG2
.set Bat_ADC__0__PA__CFG3, CYREG_UDB_PA2_CFG3
.set Bat_ADC__0__PA__CFG4, CYREG_UDB_PA2_CFG4
.set Bat_ADC__0__PA__CFG5, CYREG_UDB_PA2_CFG5
.set Bat_ADC__0__PA__CFG6, CYREG_UDB_PA2_CFG6
.set Bat_ADC__0__PA__CFG7, CYREG_UDB_PA2_CFG7
.set Bat_ADC__0__PA__CFG8, CYREG_UDB_PA2_CFG8
.set Bat_ADC__0__PA__CFG9, CYREG_UDB_PA2_CFG9
.set Bat_ADC__0__PC, CYREG_PRT2_PC
.set Bat_ADC__0__PC2, CYREG_PRT2_PC2
.set Bat_ADC__0__PORT, 2
.set Bat_ADC__0__PS, CYREG_PRT2_PS
.set Bat_ADC__0__SHIFT, 1
.set Bat_ADC__DR, CYREG_PRT2_DR
.set Bat_ADC__INTCFG, CYREG_PRT2_INTCFG
.set Bat_ADC__INTSTAT, CYREG_PRT2_INTSTAT
.set Bat_ADC__MASK, 0x02
.set Bat_ADC__PA__CFG0, CYREG_UDB_PA2_CFG0
.set Bat_ADC__PA__CFG1, CYREG_UDB_PA2_CFG1
.set Bat_ADC__PA__CFG10, CYREG_UDB_PA2_CFG10
.set Bat_ADC__PA__CFG11, CYREG_UDB_PA2_CFG11
.set Bat_ADC__PA__CFG12, CYREG_UDB_PA2_CFG12
.set Bat_ADC__PA__CFG13, CYREG_UDB_PA2_CFG13
.set Bat_ADC__PA__CFG14, CYREG_UDB_PA2_CFG14
.set Bat_ADC__PA__CFG2, CYREG_UDB_PA2_CFG2
.set Bat_ADC__PA__CFG3, CYREG_UDB_PA2_CFG3
.set Bat_ADC__PA__CFG4, CYREG_UDB_PA2_CFG4
.set Bat_ADC__PA__CFG5, CYREG_UDB_PA2_CFG5
.set Bat_ADC__PA__CFG6, CYREG_UDB_PA2_CFG6
.set Bat_ADC__PA__CFG7, CYREG_UDB_PA2_CFG7
.set Bat_ADC__PA__CFG8, CYREG_UDB_PA2_CFG8
.set Bat_ADC__PA__CFG9, CYREG_UDB_PA2_CFG9
.set Bat_ADC__PC, CYREG_PRT2_PC
.set Bat_ADC__PC2, CYREG_PRT2_PC2
.set Bat_ADC__PORT, 2
.set Bat_ADC__PS, CYREG_PRT2_PS
.set Bat_ADC__SHIFT, 1

/* Charge_PG */
.set Charge_PG__0__DM__MASK, 0xE00
.set Charge_PG__0__DM__SHIFT, 9
.set Charge_PG__0__DR, CYREG_PRT2_DR
.set Charge_PG__0__HSIOM, CYREG_HSIOM_PORT_SEL2
.set Charge_PG__0__HSIOM_MASK, 0x0000F000
.set Charge_PG__0__HSIOM_SHIFT, 12
.set Charge_PG__0__INTCFG, CYREG_PRT2_INTCFG
.set Charge_PG__0__INTSTAT, CYREG_PRT2_INTSTAT
.set Charge_PG__0__MASK, 0x08
.set Charge_PG__0__PA__CFG0, CYREG_UDB_PA2_CFG0
.set Charge_PG__0__PA__CFG1, CYREG_UDB_PA2_CFG1
.set Charge_PG__0__PA__CFG10, CYREG_UDB_PA2_CFG10
.set Charge_PG__0__PA__CFG11, CYREG_UDB_PA2_CFG11
.set Charge_PG__0__PA__CFG12, CYREG_UDB_PA2_CFG12
.set Charge_PG__0__PA__CFG13, CYREG_UDB_PA2_CFG13
.set Charge_PG__0__PA__CFG14, CYREG_UDB_PA2_CFG14
.set Charge_PG__0__PA__CFG2, CYREG_UDB_PA2_CFG2
.set Charge_PG__0__PA__CFG3, CYREG_UDB_PA2_CFG3
.set Charge_PG__0__PA__CFG4, CYREG_UDB_PA2_CFG4
.set Charge_PG__0__PA__CFG5, CYREG_UDB_PA2_CFG5
.set Charge_PG__0__PA__CFG6, CYREG_UDB_PA2_CFG6
.set Charge_PG__0__PA__CFG7, CYREG_UDB_PA2_CFG7
.set Charge_PG__0__PA__CFG8, CYREG_UDB_PA2_CFG8
.set Charge_PG__0__PA__CFG9, CYREG_UDB_PA2_CFG9
.set Charge_PG__0__PC, CYREG_PRT2_PC
.set Charge_PG__0__PC2, CYREG_PRT2_PC2
.set Charge_PG__0__PORT, 2
.set Charge_PG__0__PS, CYREG_PRT2_PS
.set Charge_PG__0__SHIFT, 3
.set Charge_PG__DR, CYREG_PRT2_DR
.set Charge_PG__INTCFG, CYREG_PRT2_INTCFG
.set Charge_PG__INTSTAT, CYREG_PRT2_INTSTAT
.set Charge_PG__MASK, 0x08
.set Charge_PG__PA__CFG0, CYREG_UDB_PA2_CFG0
.set Charge_PG__PA__CFG1, CYREG_UDB_PA2_CFG1
.set Charge_PG__PA__CFG10, CYREG_UDB_PA2_CFG10
.set Charge_PG__PA__CFG11, CYREG_UDB_PA2_CFG11
.set Charge_PG__PA__CFG12, CYREG_UDB_PA2_CFG12
.set Charge_PG__PA__CFG13, CYREG_UDB_PA2_CFG13
.set Charge_PG__PA__CFG14, CYREG_UDB_PA2_CFG14
.set Charge_PG__PA__CFG2, CYREG_UDB_PA2_CFG2
.set Charge_PG__PA__CFG3, CYREG_UDB_PA2_CFG3
.set Charge_PG__PA__CFG4, CYREG_UDB_PA2_CFG4
.set Charge_PG__PA__CFG5, CYREG_UDB_PA2_CFG5
.set Charge_PG__PA__CFG6, CYREG_UDB_PA2_CFG6
.set Charge_PG__PA__CFG7, CYREG_UDB_PA2_CFG7
.set Charge_PG__PA__CFG8, CYREG_UDB_PA2_CFG8
.set Charge_PG__PA__CFG9, CYREG_UDB_PA2_CFG9
.set Charge_PG__PC, CYREG_PRT2_PC
.set Charge_PG__PC2, CYREG_PRT2_PC2
.set Charge_PG__PORT, 2
.set Charge_PG__PS, CYREG_PRT2_PS
.set Charge_PG__SHIFT, 3

/* Charge_ST1 */
.set Charge_ST1__0__DM__MASK, 0x7000
.set Charge_ST1__0__DM__SHIFT, 12
.set Charge_ST1__0__DR, CYREG_PRT2_DR
.set Charge_ST1__0__HSIOM, CYREG_HSIOM_PORT_SEL2
.set Charge_ST1__0__HSIOM_MASK, 0x000F0000
.set Charge_ST1__0__HSIOM_SHIFT, 16
.set Charge_ST1__0__INTCFG, CYREG_PRT2_INTCFG
.set Charge_ST1__0__INTSTAT, CYREG_PRT2_INTSTAT
.set Charge_ST1__0__MASK, 0x10
.set Charge_ST1__0__PA__CFG0, CYREG_UDB_PA2_CFG0
.set Charge_ST1__0__PA__CFG1, CYREG_UDB_PA2_CFG1
.set Charge_ST1__0__PA__CFG10, CYREG_UDB_PA2_CFG10
.set Charge_ST1__0__PA__CFG11, CYREG_UDB_PA2_CFG11
.set Charge_ST1__0__PA__CFG12, CYREG_UDB_PA2_CFG12
.set Charge_ST1__0__PA__CFG13, CYREG_UDB_PA2_CFG13
.set Charge_ST1__0__PA__CFG14, CYREG_UDB_PA2_CFG14
.set Charge_ST1__0__PA__CFG2, CYREG_UDB_PA2_CFG2
.set Charge_ST1__0__PA__CFG3, CYREG_UDB_PA2_CFG3
.set Charge_ST1__0__PA__CFG4, CYREG_UDB_PA2_CFG4
.set Charge_ST1__0__PA__CFG5, CYREG_UDB_PA2_CFG5
.set Charge_ST1__0__PA__CFG6, CYREG_UDB_PA2_CFG6
.set Charge_ST1__0__PA__CFG7, CYREG_UDB_PA2_CFG7
.set Charge_ST1__0__PA__CFG8, CYREG_UDB_PA2_CFG8
.set Charge_ST1__0__PA__CFG9, CYREG_UDB_PA2_CFG9
.set Charge_ST1__0__PC, CYREG_PRT2_PC
.set Charge_ST1__0__PC2, CYREG_PRT2_PC2
.set Charge_ST1__0__PORT, 2
.set Charge_ST1__0__PS, CYREG_PRT2_PS
.set Charge_ST1__0__SHIFT, 4
.set Charge_ST1__DR, CYREG_PRT2_DR
.set Charge_ST1__INTCFG, CYREG_PRT2_INTCFG
.set Charge_ST1__INTSTAT, CYREG_PRT2_INTSTAT
.set Charge_ST1__MASK, 0x10
.set Charge_ST1__PA__CFG0, CYREG_UDB_PA2_CFG0
.set Charge_ST1__PA__CFG1, CYREG_UDB_PA2_CFG1
.set Charge_ST1__PA__CFG10, CYREG_UDB_PA2_CFG10
.set Charge_ST1__PA__CFG11, CYREG_UDB_PA2_CFG11
.set Charge_ST1__PA__CFG12, CYREG_UDB_PA2_CFG12
.set Charge_ST1__PA__CFG13, CYREG_UDB_PA2_CFG13
.set Charge_ST1__PA__CFG14, CYREG_UDB_PA2_CFG14
.set Charge_ST1__PA__CFG2, CYREG_UDB_PA2_CFG2
.set Charge_ST1__PA__CFG3, CYREG_UDB_PA2_CFG3
.set Charge_ST1__PA__CFG4, CYREG_UDB_PA2_CFG4
.set Charge_ST1__PA__CFG5, CYREG_UDB_PA2_CFG5
.set Charge_ST1__PA__CFG6, CYREG_UDB_PA2_CFG6
.set Charge_ST1__PA__CFG7, CYREG_UDB_PA2_CFG7
.set Charge_ST1__PA__CFG8, CYREG_UDB_PA2_CFG8
.set Charge_ST1__PA__CFG9, CYREG_UDB_PA2_CFG9
.set Charge_ST1__PC, CYREG_PRT2_PC
.set Charge_ST1__PC2, CYREG_PRT2_PC2
.set Charge_ST1__PORT, 2
.set Charge_ST1__PS, CYREG_PRT2_PS
.set Charge_ST1__SHIFT, 4

/* Charge_ST2 */
.set Charge_ST2__0__DM__MASK, 0x38000
.set Charge_ST2__0__DM__SHIFT, 15
.set Charge_ST2__0__DR, CYREG_PRT2_DR
.set Charge_ST2__0__HSIOM, CYREG_HSIOM_PORT_SEL2
.set Charge_ST2__0__HSIOM_MASK, 0x00F00000
.set Charge_ST2__0__HSIOM_SHIFT, 20
.set Charge_ST2__0__INTCFG, CYREG_PRT2_INTCFG
.set Charge_ST2__0__INTSTAT, CYREG_PRT2_INTSTAT
.set Charge_ST2__0__MASK, 0x20
.set Charge_ST2__0__PA__CFG0, CYREG_UDB_PA2_CFG0
.set Charge_ST2__0__PA__CFG1, CYREG_UDB_PA2_CFG1
.set Charge_ST2__0__PA__CFG10, CYREG_UDB_PA2_CFG10
.set Charge_ST2__0__PA__CFG11, CYREG_UDB_PA2_CFG11
.set Charge_ST2__0__PA__CFG12, CYREG_UDB_PA2_CFG12
.set Charge_ST2__0__PA__CFG13, CYREG_UDB_PA2_CFG13
.set Charge_ST2__0__PA__CFG14, CYREG_UDB_PA2_CFG14
.set Charge_ST2__0__PA__CFG2, CYREG_UDB_PA2_CFG2
.set Charge_ST2__0__PA__CFG3, CYREG_UDB_PA2_CFG3
.set Charge_ST2__0__PA__CFG4, CYREG_UDB_PA2_CFG4
.set Charge_ST2__0__PA__CFG5, CYREG_UDB_PA2_CFG5
.set Charge_ST2__0__PA__CFG6, CYREG_UDB_PA2_CFG6
.set Charge_ST2__0__PA__CFG7, CYREG_UDB_PA2_CFG7
.set Charge_ST2__0__PA__CFG8, CYREG_UDB_PA2_CFG8
.set Charge_ST2__0__PA__CFG9, CYREG_UDB_PA2_CFG9
.set Charge_ST2__0__PC, CYREG_PRT2_PC
.set Charge_ST2__0__PC2, CYREG_PRT2_PC2
.set Charge_ST2__0__PORT, 2
.set Charge_ST2__0__PS, CYREG_PRT2_PS
.set Charge_ST2__0__SHIFT, 5
.set Charge_ST2__DR, CYREG_PRT2_DR
.set Charge_ST2__INTCFG, CYREG_PRT2_INTCFG
.set Charge_ST2__INTSTAT, CYREG_PRT2_INTSTAT
.set Charge_ST2__MASK, 0x20
.set Charge_ST2__PA__CFG0, CYREG_UDB_PA2_CFG0
.set Charge_ST2__PA__CFG1, CYREG_UDB_PA2_CFG1
.set Charge_ST2__PA__CFG10, CYREG_UDB_PA2_CFG10
.set Charge_ST2__PA__CFG11, CYREG_UDB_PA2_CFG11
.set Charge_ST2__PA__CFG12, CYREG_UDB_PA2_CFG12
.set Charge_ST2__PA__CFG13, CYREG_UDB_PA2_CFG13
.set Charge_ST2__PA__CFG14, CYREG_UDB_PA2_CFG14
.set Charge_ST2__PA__CFG2, CYREG_UDB_PA2_CFG2
.set Charge_ST2__PA__CFG3, CYREG_UDB_PA2_CFG3
.set Charge_ST2__PA__CFG4, CYREG_UDB_PA2_CFG4
.set Charge_ST2__PA__CFG5, CYREG_UDB_PA2_CFG5
.set Charge_ST2__PA__CFG6, CYREG_UDB_PA2_CFG6
.set Charge_ST2__PA__CFG7, CYREG_UDB_PA2_CFG7
.set Charge_ST2__PA__CFG8, CYREG_UDB_PA2_CFG8
.set Charge_ST2__PA__CFG9, CYREG_UDB_PA2_CFG9
.set Charge_ST2__PC, CYREG_PRT2_PC
.set Charge_ST2__PC2, CYREG_PRT2_PC2
.set Charge_ST2__PORT, 2
.set Charge_ST2__PS, CYREG_PRT2_PS
.set Charge_ST2__SHIFT, 5

/* Clock_RTOS */
.set Clock_RTOS__DIVIDER_MASK, 0x0000FFFF
.set Clock_RTOS__ENABLE, CYREG_CLK_DIVIDER_A00
.set Clock_RTOS__ENABLE_MASK, 0x80000000
.set Clock_RTOS__MASK, 0x80000000
.set Clock_RTOS__REGISTER, CYREG_CLK_DIVIDER_A00

/* DisplayReset */
.set DisplayReset__0__DM__MASK, 0x1C0
.set DisplayReset__0__DM__SHIFT, 6
.set DisplayReset__0__DR, CYREG_PRT1_DR
.set DisplayReset__0__HSIOM, CYREG_HSIOM_PORT_SEL1
.set DisplayReset__0__HSIOM_MASK, 0x00000F00
.set DisplayReset__0__HSIOM_SHIFT, 8
.set DisplayReset__0__INTCFG, CYREG_PRT1_INTCFG
.set DisplayReset__0__INTSTAT, CYREG_PRT1_INTSTAT
.set DisplayReset__0__MASK, 0x04
.set DisplayReset__0__PA__CFG0, CYREG_UDB_PA1_CFG0
.set DisplayReset__0__PA__CFG1, CYREG_UDB_PA1_CFG1
.set DisplayReset__0__PA__CFG10, CYREG_UDB_PA1_CFG10
.set DisplayReset__0__PA__CFG11, CYREG_UDB_PA1_CFG11
.set DisplayReset__0__PA__CFG12, CYREG_UDB_PA1_CFG12
.set DisplayReset__0__PA__CFG13, CYREG_UDB_PA1_CFG13
.set DisplayReset__0__PA__CFG14, CYREG_UDB_PA1_CFG14
.set DisplayReset__0__PA__CFG2, CYREG_UDB_PA1_CFG2
.set DisplayReset__0__PA__CFG3, CYREG_UDB_PA1_CFG3
.set DisplayReset__0__PA__CFG4, CYREG_UDB_PA1_CFG4
.set DisplayReset__0__PA__CFG5, CYREG_UDB_PA1_CFG5
.set DisplayReset__0__PA__CFG6, CYREG_UDB_PA1_CFG6
.set DisplayReset__0__PA__CFG7, CYREG_UDB_PA1_CFG7
.set DisplayReset__0__PA__CFG8, CYREG_UDB_PA1_CFG8
.set DisplayReset__0__PA__CFG9, CYREG_UDB_PA1_CFG9
.set DisplayReset__0__PC, CYREG_PRT1_PC
.set DisplayReset__0__PC2, CYREG_PRT1_PC2
.set DisplayReset__0__PORT, 1
.set DisplayReset__0__PS, CYREG_PRT1_PS
.set DisplayReset__0__SHIFT, 2
.set DisplayReset__DR, CYREG_PRT1_DR
.set DisplayReset__INTCFG, CYREG_PRT1_INTCFG
.set DisplayReset__INTSTAT, CYREG_PRT1_INTSTAT
.set DisplayReset__MASK, 0x04
.set DisplayReset__PA__CFG0, CYREG_UDB_PA1_CFG0
.set DisplayReset__PA__CFG1, CYREG_UDB_PA1_CFG1
.set DisplayReset__PA__CFG10, CYREG_UDB_PA1_CFG10
.set DisplayReset__PA__CFG11, CYREG_UDB_PA1_CFG11
.set DisplayReset__PA__CFG12, CYREG_UDB_PA1_CFG12
.set DisplayReset__PA__CFG13, CYREG_UDB_PA1_CFG13
.set DisplayReset__PA__CFG14, CYREG_UDB_PA1_CFG14
.set DisplayReset__PA__CFG2, CYREG_UDB_PA1_CFG2
.set DisplayReset__PA__CFG3, CYREG_UDB_PA1_CFG3
.set DisplayReset__PA__CFG4, CYREG_UDB_PA1_CFG4
.set DisplayReset__PA__CFG5, CYREG_UDB_PA1_CFG5
.set DisplayReset__PA__CFG6, CYREG_UDB_PA1_CFG6
.set DisplayReset__PA__CFG7, CYREG_UDB_PA1_CFG7
.set DisplayReset__PA__CFG8, CYREG_UDB_PA1_CFG8
.set DisplayReset__PA__CFG9, CYREG_UDB_PA1_CFG9
.set DisplayReset__PC, CYREG_PRT1_PC
.set DisplayReset__PC2, CYREG_PRT1_PC2
.set DisplayReset__PORT, 1
.set DisplayReset__PS, CYREG_PRT1_PS
.set DisplayReset__SHIFT, 2

/* StatusRegCLK */
.set StatusRegCLK__DIVIDER_MASK, 0x0000FFFF
.set StatusRegCLK__ENABLE, CYREG_CLK_DIVIDER_A01
.set StatusRegCLK__ENABLE_MASK, 0x80000000
.set StatusRegCLK__MASK, 0x80000000
.set StatusRegCLK__REGISTER, CYREG_CLK_DIVIDER_A01

/* Charge_Status_Reg */
.set Charge_Status_Reg_sts_sts_reg__0__MASK, 0x01
.set Charge_Status_Reg_sts_sts_reg__0__POS, 0
.set Charge_Status_Reg_sts_sts_reg__1__MASK, 0x02
.set Charge_Status_Reg_sts_sts_reg__1__POS, 1
.set Charge_Status_Reg_sts_sts_reg__16BIT_STATUS_AUX_CTL_REG, CYREG_UDB_W16_ACTL_00
.set Charge_Status_Reg_sts_sts_reg__16BIT_STATUS_REG, CYREG_UDB_W16_ST_00
.set Charge_Status_Reg_sts_sts_reg__32BIT_MASK_REG, CYREG_UDB_W32_MSK_00
.set Charge_Status_Reg_sts_sts_reg__32BIT_STATUS_AUX_CTL_REG, CYREG_UDB_W32_ACTL_00
.set Charge_Status_Reg_sts_sts_reg__32BIT_STATUS_REG, CYREG_UDB_W32_ST_00
.set Charge_Status_Reg_sts_sts_reg__MASK, 0x03
.set Charge_Status_Reg_sts_sts_reg__MASK_REG, CYREG_UDB_W8_MSK_00
.set Charge_Status_Reg_sts_sts_reg__STATUS_AUX_CTL_REG, CYREG_UDB_W8_ACTL_00
.set Charge_Status_Reg_sts_sts_reg__STATUS_REG, CYREG_UDB_W8_ST_00

/* Miscellaneous */
.set CYDEV_BCLK__HFCLK__HZ, 48000000
.set CYDEV_BCLK__HFCLK__KHZ, 48000
.set CYDEV_BCLK__HFCLK__MHZ, 48
.set CYDEV_BCLK__SYSCLK__HZ, 48000000
.set CYDEV_BCLK__SYSCLK__KHZ, 48000
.set CYDEV_BCLK__SYSCLK__MHZ, 48
.set CYDEV_CHIP_DIE_LEOPARD, 1
.set CYDEV_CHIP_DIE_PANTHER, 18
.set CYDEV_CHIP_DIE_PSOC4A, 10
.set CYDEV_CHIP_DIE_PSOC5LP, 17
.set CYDEV_CHIP_DIE_TMA4, 2
.set CYDEV_CHIP_DIE_UNKNOWN, 0
.set CYDEV_CHIP_FAMILY_PSOC3, 1
.set CYDEV_CHIP_FAMILY_PSOC4, 2
.set CYDEV_CHIP_FAMILY_PSOC5, 3
.set CYDEV_CHIP_FAMILY_UNKNOWN, 0
.set CYDEV_CHIP_FAMILY_USED, CYDEV_CHIP_FAMILY_PSOC4
.set CYDEV_CHIP_JTAG_ID, 0x04C81193
.set CYDEV_CHIP_MEMBER_3A, 1
.set CYDEV_CHIP_MEMBER_4A, 10
.set CYDEV_CHIP_MEMBER_4C, 15
.set CYDEV_CHIP_MEMBER_4D, 6
.set CYDEV_CHIP_MEMBER_4E, 4
.set CYDEV_CHIP_MEMBER_4F, 11
.set CYDEV_CHIP_MEMBER_4G, 2
.set CYDEV_CHIP_MEMBER_4H, 9
.set CYDEV_CHIP_MEMBER_4I, 14
.set CYDEV_CHIP_MEMBER_4J, 7
.set CYDEV_CHIP_MEMBER_4K, 8
.set CYDEV_CHIP_MEMBER_4L, 13
.set CYDEV_CHIP_MEMBER_4M, 12
.set CYDEV_CHIP_MEMBER_4N, 5
.set CYDEV_CHIP_MEMBER_4U, 3
.set CYDEV_CHIP_MEMBER_5A, 17
.set CYDEV_CHIP_MEMBER_5B, 16
.set CYDEV_CHIP_MEMBER_UNKNOWN, 0
.set CYDEV_CHIP_MEMBER_USED, CYDEV_CHIP_MEMBER_4A
.set CYDEV_CHIP_DIE_EXPECT, CYDEV_CHIP_MEMBER_USED
.set CYDEV_CHIP_DIE_ACTUAL, CYDEV_CHIP_DIE_EXPECT
.set CYDEV_CHIP_REV_LEOPARD_ES1, 0
.set CYDEV_CHIP_REV_LEOPARD_ES2, 1
.set CYDEV_CHIP_REV_LEOPARD_ES3, 3
.set CYDEV_CHIP_REV_LEOPARD_PRODUCTION, 3
.set CYDEV_CHIP_REV_PANTHER_ES0, 0
.set CYDEV_CHIP_REV_PANTHER_ES1, 1
.set CYDEV_CHIP_REV_PANTHER_PRODUCTION, 1
.set CYDEV_CHIP_REV_PSOC4A_ES0, 17
.set CYDEV_CHIP_REV_PSOC4A_PRODUCTION, 17
.set CYDEV_CHIP_REV_PSOC5LP_ES0, 0
.set CYDEV_CHIP_REV_PSOC5LP_PRODUCTION, 0
.set CYDEV_CHIP_REV_TMA4_ES, 17
.set CYDEV_CHIP_REV_TMA4_ES2, 33
.set CYDEV_CHIP_REV_TMA4_PRODUCTION, 17
.set CYDEV_CHIP_REVISION_3A_ES1, 0
.set CYDEV_CHIP_REVISION_3A_ES2, 1
.set CYDEV_CHIP_REVISION_3A_ES3, 3
.set CYDEV_CHIP_REVISION_3A_PRODUCTION, 3
.set CYDEV_CHIP_REVISION_4A_ES0, 17
.set CYDEV_CHIP_REVISION_4A_PRODUCTION, 17
.set CYDEV_CHIP_REVISION_4C_PRODUCTION, 0
.set CYDEV_CHIP_REVISION_4D_PRODUCTION, 0
.set CYDEV_CHIP_REVISION_4E_PRODUCTION, 0
.set CYDEV_CHIP_REVISION_4F_PRODUCTION, 0
.set CYDEV_CHIP_REVISION_4F_PRODUCTION_256DMA, 0
.set CYDEV_CHIP_REVISION_4F_PRODUCTION_256K, 0
.set CYDEV_CHIP_REVISION_4G_ES, 17
.set CYDEV_CHIP_REVISION_4G_ES2, 33
.set CYDEV_CHIP_REVISION_4G_PRODUCTION, 17
.set CYDEV_CHIP_REVISION_4H_PRODUCTION, 0
.set CYDEV_CHIP_REVISION_4I_PRODUCTION, 0
.set CYDEV_CHIP_REVISION_4J_PRODUCTION, 0
.set CYDEV_CHIP_REVISION_4K_PRODUCTION, 0
.set CYDEV_CHIP_REVISION_4L_PRODUCTION, 0
.set CYDEV_CHIP_REVISION_4M_PRODUCTION, 0
.set CYDEV_CHIP_REVISION_4N_PRODUCTION, 0
.set CYDEV_CHIP_REVISION_4U_PRODUCTION, 0
.set CYDEV_CHIP_REVISION_5A_ES0, 0
.set CYDEV_CHIP_REVISION_5A_ES1, 1
.set CYDEV_CHIP_REVISION_5A_PRODUCTION, 1
.set CYDEV_CHIP_REVISION_5B_ES0, 0
.set CYDEV_CHIP_REVISION_5B_PRODUCTION, 0
.set CYDEV_CHIP_REVISION_USED, CYDEV_CHIP_REVISION_4A_PRODUCTION
.set CYDEV_CHIP_REV_EXPECT, CYDEV_CHIP_REVISION_USED
.set CYDEV_CONFIG_READ_ACCELERATOR, 1
.set CYDEV_CONFIG_UNUSED_IO_AllowButWarn, 0
.set CYDEV_CONFIG_UNUSED_IO, CYDEV_CONFIG_UNUSED_IO_AllowButWarn
.set CYDEV_CONFIG_UNUSED_IO_AllowWithInfo, 1
.set CYDEV_CONFIG_UNUSED_IO_Disallowed, 2
.set CYDEV_CONFIGURATION_COMPRESSED, 1
.set CYDEV_CONFIGURATION_MODE_COMPRESSED, 0
.set CYDEV_CONFIGURATION_MODE, CYDEV_CONFIGURATION_MODE_COMPRESSED
.set CYDEV_CONFIGURATION_MODE_DMA, 2
.set CYDEV_CONFIGURATION_MODE_UNCOMPRESSED, 1
.set CYDEV_DEBUG_PROTECT_KILL, 4
.set CYDEV_DEBUG_PROTECT_OPEN, 1
.set CYDEV_DEBUG_PROTECT, CYDEV_DEBUG_PROTECT_OPEN
.set CYDEV_DEBUG_PROTECT_PROTECTED, 2
.set CYDEV_DEBUGGING_DPS_Disable, 3
.set CYDEV_DEBUGGING_DPS_SWD, 2
.set CYDEV_DEBUGGING_DPS, CYDEV_DEBUGGING_DPS_SWD
.set CYDEV_DEBUGGING_ENABLE, 1
.set CYDEV_DFT_SELECT_CLK0, 1
.set CYDEV_DFT_SELECT_CLK1, 2
.set CYDEV_HEAP_SIZE, 0x80
.set CYDEV_IMO_TRIMMED_BY_USB, 0
.set CYDEV_IMO_TRIMMED_BY_WCO, 0
.set CYDEV_IS_EXPORTING_CODE, 0
.set CYDEV_IS_IMPORTING_CODE, 0
.set CYDEV_PROJ_TYPE, 0
.set CYDEV_PROJ_TYPE_BOOTLOADER, 1
.set CYDEV_PROJ_TYPE_LAUNCHER, 5
.set CYDEV_PROJ_TYPE_LOADABLE, 2
.set CYDEV_PROJ_TYPE_LOADABLEANDBOOTLOADER, 4
.set CYDEV_PROJ_TYPE_MULTIAPPBOOTLOADER, 3
.set CYDEV_PROJ_TYPE_STANDARD, 0
.set CYDEV_STACK_SIZE, 0x0400
.set CYDEV_USE_BUNDLED_CMSIS, 1
.set CYDEV_VARIABLE_VDDA, 1
.set CYDEV_VDDA_MV, 3300
.set CYDEV_VDDD_MV, 3300
.set CYDEV_WDT_GENERATE_ISR, 1
.set CYIPBLOCK_M0S8_CTBM_VERSION, 0
.set CYIPBLOCK_m0s8cpuss_VERSION, 0
.set CYIPBLOCK_m0s8csd_VERSION, 0
.set CYIPBLOCK_m0s8gpio2_VERSION, 0
.set CYIPBLOCK_m0s8hsiom4a_VERSION, 0
.set CYIPBLOCK_m0s8lcd_VERSION, 0
.set CYIPBLOCK_m0s8lpcomp_VERSION, 0
.set CYIPBLOCK_m0s8pclk_VERSION, 0
.set CYIPBLOCK_m0s8sar_VERSION, 0
.set CYIPBLOCK_m0s8scb_VERSION, 0
.set CYIPBLOCK_m0s8srssv2_VERSION, 1
.set CYIPBLOCK_m0s8tcpwm_VERSION, 0
.set CYIPBLOCK_m0s8udbif_VERSION, 0
.set CYIPBLOCK_S8_GPIO_VERSION, 2
.set CYDEV_BOOTLOADER_ENABLE, 0
.endif
